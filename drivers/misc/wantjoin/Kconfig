## drivers/misc/wantjoin/Kconfig
```kconfig
menu	"Wantjoin software Configuration"

source "drivers/misc/wantjoin/packflt/Kconfig"

endmenu
```

## drivers/misc/wantjoin/packflt/Kconfig
```kconfig
config WANTJOIN_PACKFLT
	tristate "wantjoin co. ltd packet filter"
	depends on NETFILTER
	default n
	help
	  A packet filter module. Say Y when you want to support this tool.
```
